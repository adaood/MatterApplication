## components/AccessPointManager/Kconfig.projbuild
```kconfig
menu "AccessPoint Manager"
    config AP_SSID
        string "SSID"
        default "MetaHouse AP"
        help 
            The SSID of the Access Point

    config AP_PASSWORD
        string "Password"
        default "123456789"
        help 
            The password of the Access Point

    config AP_CHANNEL
        int "Channel"
        default 1
        help 
            The channel of the Access Point

    config AP_MAX_CONNECTIONS
        int "Max Connections"
        default 4
        help 
            The maximum number of connections to the Access Point

    config AP_WEB_STACK_SIZE
        int "Web Stack Size"
        default 8192
        help 
            The stack size of the web server

    config AP_MAX_PATH_SIZE
        int "Max Path Size"
        default 512
        help 
            The maximum size of the path

    config AP_STREAM_BUFFER_SIZE
        int "Stream Buffer Size"
        default 1024
        help 
            The size of the stream buffer

    config AP_ACCESSORY_JSON_SIZE
        int "Accessory JSON Size"
        default 2048
        help 
            The size of the accessory JSON
endmenu
```

## components/EndpointManager/Kconfig.projbuild
```kconfig
menu "Endpoint Manager"
    config JSON_ACCESSORIES_LENGTH
        int "JSON Accessories Length"
        default 4000
            help 
                The maximum length of the JSON string that can be sent to the endpoint manager.
                This value should be set to the maximum length of the JSON string that the endpoint manager can handle.
                The default value is 4000.
endmenu
```

## components/StatusControlManager/Kconfig.projbuild
```kconfig
menu "Status Control Manager"
    config S_C_M_STATUS_LED_PIN
        int "LED Pin"
        default 2
        help
            The pin number of the LED that will be used to indicate the status of the device.

    config S_C_M_CONTROL_BUTTON_PIN
        int "Control Button Pin"
        default 5
        help
            The pin number of the button that will be used to control the device.
    
    config S_C_M_CONTROL_BUTTON_DEBOUNCE_DELAY
        int "Control Button Debounce Delay"
        default 50
        help
            The delay in milliseconds to debounce the control button.

    config S_C_M_CONTROL_BUTTON_LONG_PRESS_DELAY
        int "Control Button Long Press Delay"
        default 2000
        help
            The delay in milliseconds to consider a button press as a long press.

    config S_C_M_BLINKING_TASK_STACK_SIZE
        int "Blinking Task Stack Size"
        default 2048
        range 1024 16384
        help
            The stack size of the blinking task.

    config S_C_M_BLINKING_TASK_PRIORITY
        int "Blinking Task Priority"
        default 5
        range 1 31
        help
            The priority of the blinking task.
endmenu
```

## components/StorageManager/Kconfig.projbuild
```kconfig
menu "Storage Manager"
    config SM_NVS_NAMESPACE
        string "NVS Namespace"
        default "metahouse"
        help
          The namespace used for NVS storage.
    
    config SM_NVS_PARTITION
        string "NVS Partition"
        default "nvs"
        help
          The partition used for NVS storage.
    
    config SM_NVS_KEY_PROGRAM_MODE
        string "NVS Key Program Mode"
        default "program_mode"
        help
          The key used to store the program mode in NVS.

    config SM_NVS_KEY_DEVICE_NAME
        string "NVS Key Device Name"
        default "device_name"
        help
          The key used to store the device name in NVS.

    config SM_NVS_KEY_ACCESSORY_DB
        string "NVS Key Accessory DB"
        default "accessory_db"
        help
          The key used to store the accessory database in NVS.
endmenu
```

## components/UpdateManager/Kconfig.projbuild
```kconfig
menu "Update Manager"
    config UM_FIRMWARE_UPGRADE_URL
        string "Firmware Upgrade URL"
        
        default "https://github.com/ronny-antoon/MatterApplication/blob/master/OTA_EXAMPLE/MatterApplication.bin?raw=true"
        help
            Enter the URL of the firmware upgrade file. The URL must be a full
            URL including the protocol (http:// or https://) and the filename
            of the firmware image. The URL must be accessible from the device
            and the firmware image must be in the correct format for the device.
    
    config UM_OTA_RECV_TIMEOUT
        int "OTA Receive Timeout"
        default 5000
        help
            The time in seconds to wait for the firmware image to be received
            from the server. If the firmware image is not received within this
            time, the upgrade process will be aborted.

    config UM_HTTP_REQUEST_SIZE
        int "HTTP Request Size"
        default 1024
        help
            The size of the buffer used to receive the HTTP response from the
            server. This buffer is used to store the HTTP response headers and
            the firmware image. If the buffer is too small, the firmware image
            may be truncated and the upgrade process will fail.

    config UM_WIFI_SSID
        string "WiFi SSID"
        default "mySSID"
        help
            Enter the SSID of the WiFi network to connect to. The SSID is the
            name of the WiFi network that is broadcast by the access point.
            
    config UM_WIFI_PASSWORD
        string "WiFi Password"
        default "myPASSWORD"
        help
            Enter the password for the WiFi network. The password is used to
            authenticate the device to the access point and establish a secure
            connection.

    config UM_WIFI_CONNECT_TIMEOUT
        int "WiFi Connect Timeout"
        default 30
        help
            The time in seconds to wait for the device to connect to the WiFi
            network. If the device is unable to connect to the network within
            this time, the upgrade process will be aborted.
endmenu
```
